## Documentation/devicetree/bindings/display/panel/fascontek,fs035vg158.yaml
```yaml
# SPDX-License-Identifier: (GPL-2.0-only OR BSD-2-Clause)
%YAML 1.2
---
$id: http://devicetree.org/schemas/display/panel/fascontek,fs035vg158.yaml#
$schema: http://devicetree.org/meta-schemas/core.yaml#

title: Fascontek FS035VG158 3.5" (640x480 pixels) 24-bit IPS LCD panel

maintainers:
  - John Watts <contact@jookia.org>

allOf:
  - $ref: panel-common.yaml#
  - $ref: /schemas/spi/spi-peripheral-props.yaml#

properties:
  compatible:
    const: fascontek,fs035vg158

  reg:
    maxItems: 1

  spi-3wire: true

  pixel-format:
    description: >
      RGB interface pixel format:
      * `r5g6b5` - 16-bit pixels, d[20:16]=r, d[13:8]=g, d[4:0]=b
      * `r6g6b6` - 18-bit pixels, d[21:16]=r, d[13:8]=g, d[5:0]=b
      * `r8g8b8` - 24-bit pixels, d[23:16]=r, d[15:8]=g, d[7:0]=b
    enum:
      - r5g6b5
      - r6g6b6
      - r8g8b8
    default: r8g8b8

required:
  - compatible
  - reg
  - port
  - power-supply
  - reset-gpios

unevaluatedProperties: false

examples:
  - |
    #include <dt-bindings/gpio/gpio.h>

    spi {
        #address-cells = <1>;
        #size-cells = <0>;
        panel@0 {
            compatible = "fascontek,fs035vg158";
            reg = <0>;

            spi-3wire;
            spi-max-frequency = <3125000>;

            reset-gpios = <&gpe 2 GPIO_ACTIVE_LOW>;

            backlight = <&backlight>;
            power-supply = <&vcc>;

            port {
                panel_input: endpoint {
                    remote-endpoint = <&panel_output>;
                };
            };
        };
    };
```

## Documentation/devicetree/bindings/display/panel/sitronix,st7701.yaml
```yaml
# SPDX-License-Identifier: (GPL-2.0-only OR BSD-2-Clause)
%YAML 1.2
---
$id: http://devicetree.org/schemas/display/panel/sitronix,st7701.yaml#
$schema: http://devicetree.org/meta-schemas/core.yaml#

title: Sitronix ST7701 based LCD panels

maintainers:
  - Jagan Teki <jagan@amarulasolutions.com>

description: |
  ST7701 designed for small and medium sizes of TFT LCD display, is
  capable of supporting up to 480RGBX864 in resolution. It provides
  several system interfaces like MIPI/RGB/SPI.

  Techstar TS8550B is 480x854, 2-lane MIPI DSI LCD panel which has
  inbuilt ST7701 chip.

  Densitron DMT028VGHMCMI-1A is 480x640, 2-lane MIPI DSI LCD panel
  which has built-in ST7701 chip.

properties:
  compatible:
    items:
      - enum:
          - anbernic,rg-arc-panel
          - anbernic,rg28xx-panel
          - densitron,dmt028vghmcmi-1a
          - elida,kd50t048a
          - techstar,ts8550b
          - fascontek,fs028vg047
      - const: sitronix,st7701

  reg:
    description: DSI / SPI channel used by that screen
    maxItems: 1

  VCC-supply:
    description: analog regulator for MIPI circuit

  IOVCC-supply:
    description: I/O system regulator

  dc-gpios:
    maxItems: 1
    description:
      Controller data/command selection (D/CX) in 4-line SPI mode.
      If not set, the controller is in 3-line SPI mode.
      Disallowed for DSI.

  port: true
  reset-gpios: true
  rotation: true

  backlight: true

  pixel-format:
    description: >
      RGB interface pixel format:
      * `r5g6b5` - 16-bit pixels, d[20:16]=r, d[13:5]=g, d[4:0]=b
      * `r6g6b6` - 18-bit pixels, d[21:16]=r, d[13:8]=g, d[5:0]=b
      * `r8g8b8` - 24-bit pixels, d[23:16]=r, d[15:8]=g, d[7:0]=b
      * `r6g6b6_packed` - 18-bit pixels, d[17:12]=r, d[11:6]=g, d[5:0]=b
    enum:
      - r5g6b5
      - r6g6b6
      - r8g8b8
      - r6g6b6_packed
    default: r8g8b8

required:
  - compatible
  - reg
  - VCC-supply
  - IOVCC-supply
  - port
  - reset-gpios

allOf:
  - $ref: panel-common.yaml#
  - if:
      properties:
        compatible:
          contains:
            # SPI connected panels
            enum:
              - anbernic,rg28xx-panel
              - fascontek,fs028vg047
    then:
      $ref: /schemas/spi/spi-peripheral-props.yaml#

  - if:
      properties:
        compatible:
          not:
            contains:
              # DSI or SPI without D/CX pin
              enum:
                - anbernic,rg-arc-panel
                - anbernic,rg28xx-panel
                - densitron,dmt028vghmcmi-1a
                - elida,kd50t048a
                - techstar,ts8550b
                - fascontek,fs028vg047
    then:
      required:
        - dc-gpios
    else:
      properties:
        dc-gpios: false

  - if:
      properties:
        compatible:
          not:
            contains:
              enum:
                - fascontek,fs028vg047
    then:
      properties:
        pixel-format: false

unevaluatedProperties: false

examples:
  - |
    #include <dt-bindings/gpio/gpio.h>

    dsi {
        #address-cells = <1>;
        #size-cells = <0>;

        panel@0 {
            compatible = "techstar,ts8550b", "sitronix,st7701";
            reg = <0>;
            VCC-supply = <&reg_dldo2>;
            IOVCC-supply = <&reg_dldo2>;
            reset-gpios = <&pio 3 24 GPIO_ACTIVE_HIGH>; /* LCD-RST: PD24 */
            backlight = <&backlight>;

            port {
                mipi_in_panel: endpoint {
                    remote-endpoint = <&mipi_out_panel>;
                };
            };
        };
    };
  - |
    #include <dt-bindings/gpio/gpio.h>

    spi {
        #address-cells = <1>;
        #size-cells = <0>;

        panel@0 {
            compatible = "fascontek,fs028vg047", "sitronix,st7701";
            reg = <0>;
            spi-max-frequency = <3125000>;
            VCC-supply = <&reg_lcd>;
            IOVCC-supply = <&reg_lcd>;
            reset-gpios = <&pio 8 14 GPIO_ACTIVE_HIGH>; /* LCD-RST: PI14 */
            backlight = <&backlight>;
            pixel-format = "r8g8b8";

            port {
                panel_in_rgb: endpoint {
                    remote-endpoint = <&tcon_lcd0_out_lcd>;
                };
            };
        };
    };
```

## Documentation/devicetree/bindings/iio/adc/ti,ads1216.yaml
```yaml
# SPDX-License-Identifier: (GPL-2.0-only OR BSD-2-Clause)
%YAML 1.2
---
$id: http://devicetree.org/schemas/iio/adc/ti,ads1216.yaml#
$schema: http://devicetree.org/meta-schemas/core.yaml#

title: Texas Instruments' ADS1216 ADC chip

description: |
  The ADS1216 is an 8-channel 24-bit analog to digital converter.

maintainers:
  - John Watts <contact@jookia.org>

properties:
  compatible:
    enum:
      - ti,ads1216

  reg:
    maxItems: 1

  avdd-supply:
    description: Analog power supply, voltage up to 5V

  dvdd-supply:
    description: Digital power supply, voltage up to 5V

  vref-supply:
    description:
      Voltage reference supply, voltage up to 2.6V.
      If using the on chip voltage reference specify same as avdd-supply

  reset-gpios:
    description: Optional reset GPIO, if not specified SPI reset will be used
    maxItems: 1

  interrupts:
    description: DRDY interrupt pin, triggers on falling edge
    maxItems: 1

  ti,buf-en:
    $ref: /schemas/types.yaml#/definitions/flag
    description: Whether the BUFEN pin is set (not whether to enable the buffer)

  ti,vref-en:
    $ref: /schemas/types.yaml#/definitions/flag
    description: Whether to output the on-chip voltage reference

  ti,vref-millivolt:
    $ref: /schemas/types.yaml#/definitions/uint32
    description: The analog voltage reference voltage

  ti,rdac-ohm:
    $ref: /schemas/types.yaml#/definitions/uint32
    description: Resistance of the current DAC resistor. Set to 0 if unused

  ti,osc-hz:
    description: The crystal oscillator speed
    minimum: 1000000
    maximum: 5000000

required:
  - compatible
  - reg
  - avdd-supply
  - dvdd-supply
  - vref-supply
  - interrupts
  - ti,osc-hz
  - ti,rdac-ohm

allOf:
  - $ref: /schemas/spi/spi-peripheral-props.yaml#

unevaluatedProperties: false

examples:
  - |
    #include <dt-bindings/gpio/gpio.h>
    #include <dt-bindings/interrupt-controller/irq.h>
    spi {
        #address-cells = <1>;
        #size-cells = <0>;

        adc@1 {
          compatible = "ti,ads1216";
          reg = <1>;
          avdd-supply = <&reg_3v3>;
          dvdd-supply = <&reg_3v3>;
          vref-supply = <&reg_3v3>;
          interrupt-parent = <&pio>;
          interrupts = <4 10 IRQ_TYPE_EDGE_FALLING>;
          ti,buf-en;
          ti,vref-en;
          ti,vref-millivolt = <1250>;
          ti,rdac-ohm = <15000>;
          ti,osc-hz = <4915200>;
        };
    };
...
```
