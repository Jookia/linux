## Documentation/devicetree/bindings/sound/cirrus,cs5368.yaml
```yaml
# SPDX-License-Identifier: GPL-2.0-only OR BSD-2-Clause
%YAML 1.2
---
$id: http://devicetree.org/schemas/sound/cirrus,cs5368.yaml#
$schema: http://devicetree.org/meta-schemas/core.yaml#

title: Cirrus Logic CS5368 Audio CODEC

maintainers:
  - contact@jookia.org

description: |
  The CS5368 is a 24-bit 216kHz 8-channel audio CODEC with output via multiple
  I2S interfaces or a single TDM interface.

allOf:
  - $ref: dai-common.yaml#

properties:
  compatible:
    enum:
      - cirrus,cs5368

  reg:
    maxItems: 1

  va-supply:
    description: Power supply for analog section.

  vd-supply:
    description: Power supply for digital section.

  vlc-supply:
    description: Power supply for control port interface.

  vls-supply:
    description: Power supply for serial audio interface.

  vx-supply:
    description: Power supply for crystal oscillator.

  reset-gpios:
    description: GPIO connected to reset pin.
    maxItems: 1

  '#sound-dai-cells':
    const: 0

required:
  - compatible
  - reg
  - va-supply
  - vd-supply
  - vlc-supply
  - vls-supply
  - vx-supply
  - reset-gpios
  - '#sound-dai-cells'

additionalProperties: false

examples:
  - |
    i2c {
        #address-cells = <1>;
        #size-cells = <0>;

        cs5368: codec@4c {
            compatible = "cirrus,cs5368";
            reg = <0x4c>;
            vd-supply = <&reg_vcc5v>;
            va-supply = <&reg_3v3>;
            vls-supply = <&reg_3v3>;
            vlc-supply = <&reg_3v3>;
            vx-supply = <&reg_vcc5v>;
            reset-gpios = <&gpio 0>;
            #sound-dai-cells = <0>;
        };
    };
```
